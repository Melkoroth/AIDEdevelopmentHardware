#include <Adafruit_Circuit_Playground.h>
#include <Wire.h>
#include <SPI.h>

// *********************************************
// DEFINITIONS AND OBJECT CREATION
// *********************************************
// Color gamma correction table, this makes the hues of the NeoPixels
// a little more accurate by accounting for our eye's non-linear color
// sensitivity.  See this great guide for more details:
//   https://learn.adafruit.com/led-tricks-gamma-correction/the-issue
const uint8_t PROGMEM gamma8[] = {
    0,  0,  0,  0,  0,  0,  0,  0,  0,  0,  0,  0,  0,  0,  0,  0,
    0,  0,  0,  0,  0,  0,  0,  0,  0,  0,  0,  0,  1,  1,  1,  1,
    1,  1,  1,  1,  1,  1,  1,  1,  1,  2,  2,  2,  2,  2,  2,  2,
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  215,218,220,223,225,228,231,233,236,239,241,244,247,249,252,255 };

//Random frequencies and phases will be generated for each pixel to
//define an organic but random looking flicker effect.
float frequencies[10] = {0};     
float phases[10] = {0};          
//The value 35 degrees is a nice orange in the middle of red and yellow 
//that will look like a flame flickering as the hues animate.
const uint8_t FLAMEHUE = 35;

//Data for speaking
const uint8_t spDANGER[] PROGMEM = {0x2D,0xBF,0x21,0x92,0x59,0xB4,0x9F,0xA2,0x87,0x10,0x8E,0xDC,0x72,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0xFF,0x03};
const uint8_t spMAYDAY[] PROGMEM = {0x66,0xB7,0x52,0x7A,0xCC,0x9D,0x84,0xDD,0x4B,0xA9,0x36,0x77,0x12,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0xFF,0x01};
const uint8_t spWARNING[] PROGMEM = {0x6A,0x15,0x71,0x5C,0xDC,0x23,0x89,0x8D,0xD5,0x36,0xB5,0x8C,0x2D,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0xFE,0x1F};
const uint8_t spEMERGENCY[] PROGMEM = {0xA3,0x5B,0xCE,0x18,0x23,0x9F,0xAC,0x76,0x79,0x13,0x88,0x7C,0xB2,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0xFF,0x1F};
const uint8_t spEVACUATION[] PROGMEM = {0xA5,0xEF,0x4C,0x45,0xB6,0x16,0x95,0x71,0x6A,0x67,0xEC,0x5C,0xDD,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0xF9,0x7F};

const uint8_t spPAPA[] PROGMEM = {0x0A,0x28,0x56,0xB9,0xA5,0x45,0x55,0x84,0x49,0xCC,0x93,0x66,0xD7,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0xFF,0x03};
const uint8_t spCHARLIE[] PROGMEM = {0x06,0xD8,0x2D,0x2C,0x01,0x33,0xB7,0x67,0xA0,0xC5,0xC5,0x8D,0xC8,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0xFF,0x1F};
const uint8_t spOSCAR[] PROGMEM = {0x6B,0xC8,0xE2,0xB2,0x42,0x3A,0xDF,0xFA,0x16,0x27,0x4F,0xAE,0x7D,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0xFC,0x3F};
const uint8_t spJULIET[] PROGMEM = {0x61,0x5D,0x96,0x49,0x34,0xD2,0x06,0x60,0xC7,0x90,0x0C,0x8C,0x66,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0xFF,0x07};
const uint8_t spIS[] PROGMEM = {0xA3,0xED,0xC6,0x30,0x3D,0x57,0xAD,0x7E,0xA8,0x42,0xA9,0x5C,0xB5,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0xFF,0x07};
const uint8_t spUP[] PROGMEM = {0x69,0x2C,0x6A,0x32,0xCC,0x97,0xAC,0xA1,0xC8,0x4D,0x37,0x5F,0xB3,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0xFF,0x07};

//Stores last time we checked buttons
uint32_t lastTouchMillis = 0;
boolean leftToggle = false;
boolean rightToggle = false;
//Stores info on alarm
boolean alarmTriggered = false;

// *********************************************
// SETUP
// *********************************************
void setup() {
    CircuitPlayground.begin();
    CircuitPlayground.redLED(HIGH);

    Serial.begin(115200);
    Serial.println();
    Serial.println("CircuitPlaygroundExpress is Alive!");

    // Read the sound sensor and use it to initialize the random number generator.
    randomSeed(CircuitPlayground.soundSensor());
    // Precompute random frequency and phase values for each pixel.
    // This gives the flicker an organic but random looking appearance.
    for (int i=0; i<10; ++i) {
        // Generate random floating point frequency values between 1.0 and 4.0.
        frequencies[i] = random(1000, 4000)/1000.0;
        // Generate random floating point phase values between 0 and 2*PI.
        phases[i] = random(1000)/1000.0 * 2.0 * PI;
    }

    CircuitPlayground.redLED(LOW);
}

// *********************************************
// MAIN LOOP LOGIC
// *********************************************
void loop() {
    uint32_t millisNow = millis();
    checkButtons(millisNow);
    checkSerial();

    //Alarm is triggered through serial and processed here
    if (alarmTriggered) {
        showLitFlicker(millisNow);
    } else {
        CircuitPlayground.strip.clear();
        CircuitPlayground.strip.show();
    }

    //If button is pressed then we deactivate the alarm and inform
    if ((rightToggle || leftToggle) && alarmTriggered) {
      alarmTriggered = false;
      Serial.print("b");
      leftToggle = false;
      rightToggle = false;
    }
}

//Checks serial for "a" to activate alarm or "d" to deactivate
void checkSerial() {
  if (Serial.available()) {
    char inChar = Serial.read();
    if (inChar == 'a' || inChar == 'A') {
      triggerAlarm();
    } else if (inChar == 'd' || inChar == 'D') {
      deactivateAlarm();
    }
    //Clear buffer
    while (Serial.available()) {
      Serial.read();
    }
  }
}

void triggerAlarm() {
  /*CircuitPlayground.speaker.say(spEMERGENCY);
  delay(25);
  CircuitPlayground.speaker.say(spJULIET);
  delay(25);
  CircuitPlayground.speaker.say(spIS);
  delay(25);
  CircuitPlayground.speaker.say(spUP);
  delay(25);
  CircuitPlayground.speaker.say(spEMERGENCY);*/
  alarmTriggered = true;
}

void deactivateAlarm() {
  alarmTriggered = false;
}

//Check button presses
void checkButtons(uint32_t millisNow) {
    if (millisNow - lastTouchMillis > 250) {
        lastTouchMillis = millisNow;
        if (CircuitPlayground.leftButton()) {
            //Serial.println("Left button pressed!");
            leftToggle = true;
        }
        if (CircuitPlayground.rightButton()) {
            //Serial.println("Right button pressed!");
            rightToggle = true;
        }
    } 
}

// *********************************************
// CANDLE EFFECT FUNCTIONS
// *********************************************
// Helper to change the color of a NeoPixel on the Circuit Playground board.
// Will automatically convert from HSV color space to RGB and apply gamma
// correction.
void setPixelHSV(int i, float h, float s, float v) {
  // Convert HSV to RGB
  float r, g, b = 0.0;
  HSVtoRGB(&r, &g, &b, h, s, v);
  // Lookup gamma correct RGB colors (also convert from 0...1.0 RGB range to 0...255 byte range).
  uint8_t r1 = pgm_read_byte(&gamma8[int(r*255.0)]);
  uint8_t g1 = pgm_read_byte(&gamma8[int(g*255.0)]);
  uint8_t b1 = pgm_read_byte(&gamma8[int(b*255.0)]);
  // Set the color of the pixel.
  CircuitPlayground.strip.setPixelColor(i, r1, g1, b1);
}

// Flickering candle animation effect.
// Uses a noisey sine wave to modulate the hue of each pixel within a range
// of flame colors.  The sine wave has some low and high frequency components
// which give it an organice and seemingly random appearance.
void showLitFlicker(uint32_t current) {
    // First determine the low and high bounds of the flicker hues.
    // These are +/- 10 degrees of the specified target hue and will
    // wrap around to the start/end as appropriate.
    float lowHue = fmod(FLAMEHUE - 10.0, 360.0);
    float highHue = fmod(FLAMEHUE + 10.0, 360.0);
    // Convert time from milliseconds to seconds.
    float t = current/1000.0;
    // Loop through each pixel and compute its color.
    for (int i=0; i<10; ++i) {
        // This pixel should be lit, so compute its hue by composing
        // a low frequency / slowly changing sine wave with a high
        // frequency / fast changing cosine wave.  This means the candle will
        // pulse and jump around in an organice but random looking way.
        // The frequencies and phases of the waves are randomly generated at
        // startup in the setup function.
        // Low frequency wave is a sine wave with random freuqency between 1 and 4,
        // and offset by a random phase to keep pixels from all starting at the same
        // color:
        float lowFreq  = sin(2.0*PI*frequencies[i]*t + phases[i]);
        // High frequency is a faster changing cosine wave that uses a different
        // pixel's random frequency.
        float highFreq = cos(3.0*PI*frequencies[(i+5)%10]*t);
        // Add the low and high frequency waves together, then interpolate their value
        // to a hue that's +/-20% of the configured target hue.
        float h = lerp(lowFreq+highFreq, -2.0, 2.0, lowHue, highHue);
        setPixelHSV(i, h, 1.0, 1.0);
    }
    CircuitPlayground.strip.show();
}

// HSV to RGB color space conversion function taken directly from:
//  https://www.cs.rit.edu/~ncs/color/t_convert.html
void HSVtoRGB( float *r, float *g, float *b, float h, float s, float v ) {
  int i;
  float f, p, q, t;
  if( s == 0 ) {
    // achromatic (grey)
    *r = *g = *b = v;
    return;
  }
  h /= 60;      // sector 0 to 5
  i = floor( h );
  f = h - i;      // factorial part of h
  p = v * ( 1 - s );
  q = v * ( 1 - s * f );
  t = v * ( 1 - s * ( 1 - f ) );
  switch( i ) {
    case 0:
      *r = v;
      *g = t;
      *b = p;
      break;
    case 1:
      *r = q;
      *g = v;
      *b = p;
      break;
    case 2:
      *r = p;
      *g = v;
      *b = t;
      break;
    case 3:
      *r = p;
      *g = q;
      *b = v;
      break;
    case 4:
      *r = t;
      *g = p;
      *b = v;
      break;
    default:    // case 5:
      *r = v;
      *g = p;
      *b = q;
      break;
  }
}

// Linear interpolation of value y within y0...y1 given x and x0...x1.
float lerp(float x, float x0, float x1, float y0, float y1) {
  return y0 + (x - x0) * ((y1 - y0) / (x1 - x0));
}

  /************* TEST CAPTOUCH */
  // Serial.print("Capsense #3: "); Serial.println(CircuitPlayground.readCap(3));
  // Serial.print("Capsense #2: "); Serial.println(CircuitPlayground.readCap(2));
  // if (! CircuitPlayground.isExpress()) {  // CPX does not have this captouch pin
  //   Serial.print("Capsense #0: "); Serial.println(CircuitPlayground.readCap(0));
  // }
  // Serial.print("Capsense #1: "); Serial.println(CircuitPlayground.readCap(1));
  // Serial.print("Capsense #12: "); Serial.println(CircuitPlayground.readCap(12));
  // Serial.print("Capsense #6: "); Serial.println(CircuitPlayground.readCap(6));
  // Serial.print("Capsense #9: "); Serial.println(CircuitPlayground.readCap(9));
  // Serial.print("Capsense #10: "); Serial.println(CircuitPlayground.readCap(10));
  
  /************* TEST SLIDE SWITCH */
  // if (CircuitPlayground.slideSwitch()) {
  //   Serial.println("Slide to the left");
  // } else {
  //   Serial.println("Slide to the right");
  //   //CircuitPlayground.playTone(500 + pixeln * 500, 100);
  // }

  // /************* TEST 10 NEOPIXELS */
  // CircuitPlayground.setPixelColor(pixeln++, CircuitPlayground.colorWheel(25 * pixeln));
  // if (pixeln == 11) {
  //   pixeln = 0;
  //   CircuitPlayground.clearPixels();
  // }

  // /************* TEST BOTH BUTTONS */
  // if (CircuitPlayground.leftButton()) {
  //   Serial.println("Left button pressed!");
  // }
  // if (CircuitPlayground.rightButton()) {
  //   Serial.println("Right button pressed!");
  // }

  // /************* TEST LIGHT SENSOR */
  // Serial.print("Light sensor: ");
  // Serial.println(CircuitPlayground.lightSensor());

  // /************* TEST SOUND SENSOR */
  // Serial.print("Sound sensor: ");
  // Serial.println(CircuitPlayground.mic.soundPressureLevel(10));

  // /************* TEST ACCEL */
  // // Display the results (acceleration is measured in m/s*s)
  // Serial.print("X: "); Serial.print(CircuitPlayground.motionX());
  // Serial.print(" \tY: "); Serial.print(CircuitPlayground.motionY());
  // Serial.print(" \tZ: "); Serial.print(CircuitPlayground.motionZ());
  // Serial.println(" m/s^2");

  // /************* TEST THERMISTOR */
  // Serial.print("Temperature ");
  // Serial.print(CircuitPlayground.temperature());
  // Serial.println(" *C");
